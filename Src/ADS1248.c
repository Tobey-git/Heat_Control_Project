/**
  ******************************************************************************
  * @file    ADS1248.c
  * @author  Tobey
  * @version V1.0.0
  * @date    28-July-2016
  * @brief   本文件是ADS1248芯片的驱动模块
  * 				 本文件提供下列功能用于对ADS1248进行管理
	*						+ 初始化ADS1248
	*						+ 复位ADS1248（SPI）
	*						+ 校准ADS1248（自偏移、偏移、增益校准）
	*						+ 切换通道（0-6）
	*						+ 启动AD转换
	*						+ 延迟
	*						+ 忙状态判断
	*						+ 读取ADS1248中的AD数据
	*						+ 往ADS1248中写入命令（SPI）
	*						+ 写入数据到指定寄存器
	*						+ 读取指定寄存器数据
	*						+ 配置转换参数(增益、转换速率)
	*						+ 停止AD转换，进入低功耗模式
	*           + 获取指定通道的AD数据
  ******************************************************************************
  * @attention
	*
	********* 根据用户使用的引脚不同，需要对相应的宏定义进行修改(ADS1248.H) ************
	**** 修改引脚的端口及引脚号宏定义
	*	参见ADS1248.H中的"Definition for ADS1248"部分 
	*
	********* 使用方式 *********
	* 1、在源文件中引入驱动头文件
	*		#include "ADS1248.h"
	* 2、初始化ADS1248：
	*   ADS1248_Init(ADC_GAIN_xx|ADC_SPS_xx): 初始化 ADS1248
	*	3、读取指定通道中的AD数据：
	* 	Data = ADS1248_Channel_Data(i): 读取指定通道i的AD数据
	*
  ******************************************************************************
  */

/* Includes ------------------------------------------------------------------*/
#include "ADS1248.h"


/* Private typedef -----------------------------------------------------------*/
/* Private define ------------------------------------------------------------*/
/* Private macro -------------------------------------------------------------*/
/* Private variables ---------------------------------------------------------*/
/* Private function prototypes -----------------------------------------------*/

/**
  * @brief  温度-AD值对照表.
  */
const float pt100_table[4021] =/*PT100 -1-401度对应的AD值，0.1度间隔*/
{
		-6566020, -6562626, -6559232, -6555837, -6552443, -6549049, -6545655, -6542261, -6538866, -6535472, 
		-6532078, -6528904, -6525730, -6522557, -6519383, -6516209, -6513035, -6509861, -6506688, -6503514, 
		-6500340, -6497166, -6493992, -6490818, -6487644, -6484471, -6481297, -6478123, -6474949, -6471775, 
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		5466347, 5469569, 5472791, 5476012, 5479234, 5482456, 5485678, 5488900, 5492121, 5495343, 
		5498565

};

/**
  * @brief  延迟.
  * @param  None.
  * @note   延迟时间度量为滴答节拍间隔：例如RTX滴答设置为1ms，则os_dly_wait(1)表示延迟为1ms
  * @retval None
  */
void Delay(void)
{
	os_dly_wait(1);																			// 延迟ms个滴答节拍
}

/**
  * @brief  复位ADS1248(SPI).
  * @param  None.
  * @note   仅复位SPI，寄存器和数字滤波器未复位.
  * @retval None
  */
void ADS1248_Reset(void)
{
	
	  ADC_SPI_CS_SET																																			// 拉高片选引脚
    ADC_START_SET
    HAL_GPIO_WritePin(ADS1248_RESET_GPIO_PORT,ADS1248_RESET_GPIO_PIN,GPIO_PIN_RESET);		// 置低复位引脚
	  Delay();
    HAL_GPIO_WritePin(ADS1248_RESET_GPIO_PORT,ADS1248_RESET_GPIO_PIN,GPIO_PIN_SET);
	  Delay();

}

/**
  * @brief  启动AD转换.
  * @param  CovMode: AD转换模式.
  *          传入参数可为下述值:
  *            @arg ADC_MODE_SINGLECOV: 单次转换模式 
  *            @arg ADC_MODE_CONTINUOUS: 连续转换模式 
  * @note   根据指定模式启用转换.
  * @retval None
  */
void ADS1248_Start(uint8_t CovMode)  
{  
    ADC_START_SET                           								//启动ADC采样  
    if(CovMode==ADC_MODE_SINGLECOV)ADC_START_CLR            //单次采样模式则停止转换 
}  

/**
  * @brief  停止AD转换.
  * @param  None.
  * @note   进入低功耗模式.
  * @retval None
  */
void ADS1248_Stop(void)  
{  
    ADC_START_CLR                           //停止转换  
} 

/**
  * @brief  往ADS1248中写入命令（SPI）.
  * @param  Cmd: 需要写入的命令.
  * @note   None.
  * @retval None
  */
void ADS1248_WriteCmd(uint8_t Cmd)  
{  
    ADC_SPI_CS_CLR  
    HAL_SPI_Transmit(&ADS1248_SPI, &Cmd, 1,HAL_MAX_DELAY);
    ADC_SPI_CS_SET  
} 

/**
  * @brief  读取寄存器中的数据.
  * @param  RegAddr: 指定寄存器地址.
  * @param	*Buffer：读取到的数据指针地址.
	* @param	Length：需要读取的数据长度.
  * @note   None.
  * @retval None
  */
void ADS1248_ReadReg(uint8_t RegAddr,uint8_t *Buffer,uint8_t Length)  
{  
    uint8_t Cmd[2];  
    ADC_SPI_CS_CLR  
    Cmd[0]=ADC_CMD_RREG|RegAddr;  
    Cmd[1]=Length-1;  
    HAL_SPI_Transmit(&ADS1248_SPI, Cmd, 2,HAL_MAX_DELAY); 
	  HAL_SPI_Receive(&ADS1248_SPI, Buffer, Length, HAL_MAX_DELAY);

    Cmd[0]=ADC_CMD_NOP;  
    HAL_SPI_Transmit(&ADS1248_SPI, Cmd,1,HAL_MAX_DELAY); 	
 //   ADC_WriteBytes(Cmd,1);  
    ADC_SPI_CS_SET  
}

/**
  * @brief  写入数据到指定寄存器.
  * @param  RegAddr: 指定寄存器地址.
  * @param	*Buffer：需要写入的数据指针.
	* @param	Length：写入数据长度.
  * @note   None.
  * @retval None
  */
void ADS1248_WriteReg(uint8_t RegAddr,uint8_t *Buffer,uint8_t Length)  
{  
    uint8_t Cmd[2];  
    ADC_SPI_CS_CLR  
    Cmd[0]=ADC_CMD_WREG|RegAddr;  
    Cmd[1]=Length-1;  
	  HAL_SPI_Transmit(&ADS1248_SPI, Cmd, 2,HAL_MAX_DELAY); 	//指定向指定寄存器写入指定字节数据
  //  ADC_WriteBytes(Cmd,2);  
	  HAL_SPI_Transmit(&ADS1248_SPI, Buffer, Length,HAL_MAX_DELAY); 	//发送数据字节
 //   ADC_WriteBytes(Buffer,Length);  
    ADC_SPI_CS_SET  
}

/**
  * @brief  忙状态判断.
  * @param  None.
  * @note   最长等待时间.
  * @retval None
  */
uint8_t ADS1248_WaitBusy()  
{  
    uint16_t i;  
    ADC_SPI_CS_CLR  
    i=0;  
    while(HAL_GPIO_ReadPin(ADS1248_DRDY_GPIO_PORT, ADS1248_DRDY_GPIO_PIN)){  // 等待就绪（等待DRDY为0）
        Delay();  
        i++; if(i>20000)return 1;  
    }  
    ADC_SPI_CS_SET  
    return 0;  
}  

/**
  * @brief  配置转换参数.
  * @param  CovGain: 转换增益.
  * @param	CovRate：转换速率.
  * @note   None.
  * @retval None
  */
void ADS1248_Config(uint8_t CovGain,uint8_t CovRate)  
{  
    uint8_t Cmd;    
    Cmd=CovGain|CovRate;  
    ADS1248_WriteReg(ADC_REG_SYS0,&Cmd,1);              //设置采样增益和速率   
} 

/**
  * @brief  读取ADS1248中的转换数据.
  * @param  None.
	* @note   None.
  * @retval D：AD数值
  */
int32_t ADS1248_Read(void)  
{  
    uint8_t  Cmd[5]={ADC_CMD_RDATA,ADC_CMD_NOP,ADC_CMD_NOP,ADC_CMD_NOP,ADC_CMD_NOP};//为什么发5个？P47
    uint8_t  Buf[5];
    int32_t D;  
    ADC_SPI_CS_CLR        
		HAL_SPI_TransmitReceive(&ADS1248_SPI,Cmd,Buf,4,HAL_MAX_DELAY);			// 读取最新转换数据(32位数据？)

    ADC_SPI_CS_SET  
    D=Buf[1];
		D=D*256+Buf[2];
		D=D*256+Buf[3];
		D=D*256+Buf[4];
		D=D/256;
    return D;  
		
//		uint8_t  Cmd[5]={ADC_CMD_RDATA,ADC_CMD_NOP,ADC_CMD_NOP,ADC_CMD_NOP,ADC_CMD_NOP};//为什么发5个？P47
//    uint8_t  Buf[3];
//    int32_t D;  
//    ADC_SPI_CS_CLR        
//		HAL_SPI_TransmitReceive(&ADS1248_SPI,Cmd,Buf,5,HAL_MAX_DELAY);			// 读取最新转换数据(32位数据？)

//    ADC_SPI_CS_SET  
//    D=(int32_t)(Buf[0] << 16) + (Buf[1] << 8) + Buf[2]; // 左移8位，放大256倍识别正负号
//    return D; // 右移8位恢复原值  
		
}

/**
  * @brief  切换ADS1248通道.
  * @param  Ch：通道编号.
  *          传入参数可为下述值:
  *            @arg 0: RT0
  *            @arg 1: RT1
  *            @arg 2: RT2
  *            @arg 3: RT3
  *            @arg 4: RT4
  *            @arg 5: RT5
  *            @arg 6: RT6
  * @note   None.
  * @retval None
  */
void Change_Channel(uint8_t Ch)
{
    uint8_t Cmd;
	
    Cmd=Ch<<3;																			// 将通道左移3位
	  Cmd|=0x07;
	
	  ADS1248_Start(ADC_MODE_CONTINUOUS);							// 启动ADC（连续转换模式）
	
    ADS1248_WriteReg(ADC_REG_MUX0,&Cmd,1);  				// 设置通道正极输入为（Ch），负极输入端为：AIN7 （因为000与0x07做或运算，结果恒为111）
	
    Cmd=0x70|Ch;
    ADS1248_WriteReg(ADC_REG_IDAC1,&Cmd,1);  				// 恒流源设置：第一个恒流源输出引脚为AIN7，第二个恒流源连接于指定通道Ch(0-6) --> AIN(0-6)
	  ADS1248_Stop();																	// 进入睡眠模式
	
	
}

/**
  * @brief  对ADS1248进行校准.
  * @param  Gain：校准增益.
  * @note   校准顺序为：自偏移校准->偏移校准->增益校准 .
  * @retval R：校准完成标志位
  */
uint8_t ADS1248_Calibrate(uint8_t Gain)  
{  
    uint8_t R=0,Cmd;  
    ADS1248_WriteReg(ADC_REG_SYS0,&Gain,1);      // 设置增益值、ADC输出数据率
  
    Cmd=0x20;  
    ADS1248_WriteReg(ADC_REG_MUX1,&Cmd,1);       // 设置系统监测为自偏移测量 
    ADS1248_WriteCmd(ADC_CMD_SELFOCAL);          // 自偏移校准  
    R|=ADS1248_WaitBusy();                       // 等待校准完成 
  
    Cmd=0x21;  
    ADS1248_WriteReg(ADC_REG_MUX1,&Cmd,1);       // 设置系统监测为偏移测量  
    ADS1248_WriteCmd(ADC_CMD_SYSOCAL);           // 系统偏移校准  
    R|=ADS1248_WaitBusy();                       // 等待校准完成  
  
    Cmd=0x22;  
    ADS1248_WriteReg(ADC_REG_MUX1,&Cmd,1);       // 设置系统监测为增益测量  
    ADS1248_WriteCmd(ADC_CMD_SYSGCAL);           // 系统增益校准  
    R|=ADS1248_WaitBusy();                        
 
    return R;  
} 

/**
  * @brief  ADS1248初始化.
  * @param  Gain：校准增益.
  * @note   初始化寄存器，读取器件ID，进行芯片自动校准过程 .
  * @retval Cmd：校准结果
	* @note 为什么先初始化寄存器再校准？为什么不是先校准在初始化寄存器？顺序不同结果不同！这该怎么解释？
  */
uint8_t ADS1248_Init(uint8_t Gain)  
{  
	uint8_t Cmd;
	
	ADS1248_Reset();  																	// SPI复位
	ADS1248_WriteCmd(ADC_CMD_RESET);  									// 复位设备至上电状态(不对SPI进行复位) 20psp需要0.6ms
	Delay();  

	Cmd=0x20 ;//00100000
	ADS1248_WriteReg(ADC_REG_MUX1,&Cmd,1);            	// 将MUX1置，(内部晶振时钟源，启动内部参考电压，选择REF0输出对，普通操作)																												// 校准时MUX1将被重新赋值，因此这里可以不用对其进行赋值，校准之后再配置内部参考电压
	
	ADS1248_WriteReg(ADC_REG_SYS0,&Gain,1);             // 设置增益值、ADC输出数据率  	

	Cmd=0x07 ;//00 000 111
	ADS1248_WriteReg(ADC_REG_MUX0,&Cmd,1);  						// 选择输入通道负极(AIN7)

	Cmd=0x07 ;//00000111
	ADS1248_WriteReg(ADC_REG_IDAC0,&Cmd,1);   					// 设置极大恒流源电流值1500uA（1.5mA）

	Cmd=0x07 ;//00000111
	ADS1248_WriteReg(ADC_REG_IDAC1,&Cmd,1);   					// 选择第二个电流源输出引脚（AIN7）

	Cmd=ADC_CMD_NOP;  
	ADS1248_ReadReg(ADC_REG_IDAC0,&Cmd,1);              // 读取器件ID   
	
	Cmd=ADS1248_Calibrate(Gain);                        // 通道校准  

	Cmd=0x20;  //00100000
	ADS1248_WriteReg(ADC_REG_MUX1,&Cmd,1);							// 启用内部参考电压总是开启

	ADS1248_Stop();
	return(Cmd);  
} 

/**
  * @brief  获取指定通道的AD数据.
  * @param  Ch：通道编号.
  *          传入参数可为下述值:
  *            @arg 0: RT0
  *            @arg 1: RT1
  *            @arg 2: RT2
  *            @arg 3: RT3
  *            @arg 4: RT4
  *            @arg 5: RT5
  *            @arg 6: RT6
  * @note   None.
  * @retval Data: AD数据
  */
int32_t ADS1248_Channel_Data(uint8_t Ch)
{
	int32_t Data;
	Change_Channel(Ch);	

	ADS1248_Start(ADC_MODE_SINGLECOV);
	ADS1248_WaitBusy();//16MS p73

	Data=ADS1248_Read(); 
	return Data;
}

/*******************************************************************************
* @Function Name: ADS1248_ResToTemp
* @brief  二分法查表，将PT100的电阻值所对应的AD值转为对应温度0-100
* @param  ad：AD值
* @note   None.
* @retval 查表失败返回-1，否则返回温度值
*******************************************************************************/
float ADS1248_AdToTemp(int32_t ad)
{
	
    uint16_t low = 0;
    uint16_t mid = sizeof(pt100_table) / sizeof(pt100_table[0]) / 2;
    uint16_t high = sizeof(pt100_table) / sizeof(pt100_table[0]) - 1;

    if((ad < pt100_table[0]) || (ad > pt100_table[high]))
    {
        return -55; // 超限，不做特殊处理
    }

    while(high >= low)
    {
        mid = (high + low) / 2;

        if(ad >= pt100_table[mid])
        {
            if(ad < pt100_table[mid + 1])
            {
                return (0.1 * mid + (ad - pt100_table[mid]) * 0.1 / ((pt100_table[mid + 1]) - pt100_table[mid]) - 1);
            }
            else
            {
                low = mid + 1;
            }
        }
        else if(ad < pt100_table[mid])
        {
            high = mid - 1;
        }
    }
		return -55;
}


/************************ (C) COPYRIGHT Tobey *****END OF FILE****/		
